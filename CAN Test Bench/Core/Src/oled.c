/*
 * oled.c
 *
 *  Created on: Nov 12, 2024
 *      Author: byo10
 */

#include <stdio.h>

#include <string.h>

#include "oled.h"
#include "main.h"
#include "uvfr_utils.h"

#ifdef USE_OLED_DEBUG

SPI_HandleTypeDef SPI_Handle;

//could not tell you what's up here
unsigned char oled_init_cmds[] =
{
    0xAE,
    0x20, 0x00,
    0x40,
    0xA0 | 0x01,
    0xA8, 0x40 - 1,
    0xC0 | 0x08,
    0xD3, 0x00,
    0xDA, 0x32,
    0xD5, 0x80,
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    0x8D, 0x10,
    0xAE | 0x01,
    0xC0,
    0xA0
};


//
// Character specifications for LED Display (1 row = 8 bytes = 1 ASCII character)
// Example: to display '4', retrieve 8 data bytes stored in Characters[52][X] row
//          (where X = 0, 1, ..., 7) and send them one by one to LED Display.
// Row number = character ASCII code (e.g., ASCII code of '4' is 0x34 = 52)
//
unsigned char Characters[][8] = {
    {0b00000000, 0b00000000, 0b00000000, 0b00000000, 0b00000000,0b00000000, 0b00000000, 0b00000000},  // SPACE
    {0b00000000, 0b00000000, 0b00000000, 0b00000000, 0b00000000,0b00000000, 0b00000000, 0b00000000},  // SPACE
    {0b00000000, 0b00000000, 0b00000000, 0b00000000, 0b00000000,0b00000000, 0b00000000, 0b00000000},  // SPACE
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    {0b00001000, 0b00011100, 0b00101010, 0b00001000, 0b00001000,0b00000000, 0b00000000, 0b00000000}   // <-
};

void refresh_OLED(volatile unsigned int Freq, volatile unsigned int Res)
{
    // Buffer size = at most 16 characters per PAGE + terminating '\0'
    unsigned char Buffer[17];

    snprintf( Buffer, sizeof( Buffer ), "R: %5u Ohms", Res );
    /* Buffer now contains your character ASCII codes for LED Display
       - select PAGE (LED Display line) and set starting SEG (column)
       - for each c = ASCII code = Buffer[0], Buffer[1], ...,
           send 8 bytes in Characters[c][0-7] to LED Display
    */
    oled_Write_Cmd(0xB0); //first page
    oled_Write_Cmd(0x04); //reset column
    oled_Write_Cmd(0x10);

    for (int i = 0; i < sizeof( Buffer ); i++){
    	char c = Buffer[i];
    	if( c == '\0'){
    		break;
    	}
    	for( int c_byte = 0; c_byte < 8; c_byte++){
    		oled_Write_Data(Characters[c][c_byte]);
    	}

    }

    snprintf( Buffer, sizeof( Buffer ), "F: %5u Hz", Freq );
//    /* Buffer now contains your character ASCII codes for LED Display
//       - select PAGE (LED Display line) and set starting SEG (column)
//       - for each c = ASCII code = Buffer[0], Buffer[1], ...,
//           send 8 bytes in Characters[c][0-7] to LED Display
//    */
//
    oled_Write_Cmd(0xB3); //page 3
    oled_Write_Cmd(0x04); //reset column
    oled_Write_Cmd(0x10);

    for (int i = 0; i < sizeof( Buffer ); i++){
    	char c = Buffer[i];
    	if( c == '\0'){
    		break;
    	}
    	for( int c_byte = 0; c_byte < 8; c_byte++){
    		oled_Write_Data(Characters[(int)c][c_byte]);
    	}

   }
    // Fixes glitch with 6 digit frequency
    for( int c_byte = 0; c_byte < 8; c_byte++){
        	    oled_Write_Data(Characters[' '][c_byte]);
    }
//
//
//	/* Wait for ~100 ms (for example) to get ~10 frames/sec refresh rate
//       - You should use TIM3 to implement this delay (e.g., via polling)
//    */
//
//    ...

}


void oled_Write_Cmd( unsigned char cmd )
{
//    ... // make PB6 = CS# = 1
	GPIOB->BSRR = 0x1<<6;

//    ... // make PB7 = D/C# = 0
	GPIOB->BSRR = 0x1<<23;

//    ... // make PB6 = CS# = 0
	GPIOB->BSRR = 0x1<<22;

    oled_Write( cmd );

//    ... // make PB6 = CS# = 1
    GPIOB->BSRR = 0x1<<6;
}

void oled_Write_Data( unsigned char data )
{
    //... // make PB6 = CS# = 1
	GPIOB->BSRR = 0x1<<6;

    //... // make PB7 = D/C# = 1
	GPIOB->BSRR = 0x1<<7;

    //... // make PB6 = CS# = 0
	GPIOB->BSRR = 0x1<<22;

    oled_Write( data );

    //... // make PB6 = CS# = 1
    GPIOB->BSRR = 0x1<<6;
}


void oled_Write( unsigned char Value )
{

    /* Wait until SPI1 is ready for writing (TXE = 1 in SPI1_SR) */

   while((SPI1->SR & SPI_SR_TXE) == 0 ){}

    /* Send one 8-bit character:
       - This function also sets BIDIOE = 1 in SPI1_CR1
    */
    HAL_SPI_Transmit( &SPI_Handle, &Value, 1, HAL_MAX_DELAY );

    /* Wait until transmission is complete (TXE = 1 in SPI1_SR) */

    while((SPI1->SR & SPI_SR_TXE) == 0 ){}

}


void oled_config( void ){

// Don't forget to enable GPIOB clock in RCC - Done
// Don't forget to configure PB3/PB5 as AF0 - Done
// Don't forget to enable SPI1 clock in RCC - Done

	RCC->APB2ENR |= 0x1000; //enable SPI1 clock

    SPI_Handle.Instance = SPI1;

    SPI_Handle.Init.Direction = SPI_DIRECTION_1LINE;
    SPI_Handle.Init.Mode = SPI_MODE_MASTER;
    SPI_Handle.Init.DataSize = SPI_DATASIZE_8BIT;
    SPI_Handle.Init.CLKPolarity = SPI_POLARITY_LOW;
    SPI_Handle.Init.CLKPhase = SPI_PHASE_1EDGE;
    SPI_Handle.Init.NSS = SPI_NSS_SOFT;
    SPI_Handle.Init.BaudRatePrescaler = SPI_BAUDRATEPRESCALER_256;
    SPI_Handle.Init.FirstBit = SPI_FIRSTBIT_MSB;
    SPI_Handle.Init.CRCPolynomial = 7;

//
// Initialize the SPI interface
//
    HAL_SPI_Init( &SPI_Handle );

//
// Enable the SPI
//
    __HAL_SPI_ENABLE( &SPI_Handle );


    /* Reset LED Display (RES# = PB4):
       - make pin PB4 = 0, wait for a few ms
       - make pin PB4 = 1, wait for a few ms
    */
    //...
    GPIOB->BSRR = 0x1<<20;
    wait(10);
    GPIOB->BSRR = 0x1<<4;


//
// Send initialization commands to LED Display
//
    for ( unsigned int i = 0; i < sizeof( oled_init_cmds ); i++ ){
        oled_Write_Cmd( oled_init_cmds[i] );
    }

    /* Fill LED Display data memory (GDDRAM) with zeros:
       - for each PAGE = 0, 1, ..., 7
           set starting SEG = 0
           call oled_Write_Data( 0x00 ) 128 times
    */

    for (unsigned int i = 0;  i<8; i++){
    	oled_Write_Cmd(0xB0 | ((unsigned char)i));
    	oled_Write_Cmd(0x02);
    	oled_Write_Cmd(0x10);

    	for(unsigned int j = 0; j<128; j++){

    		oled_Write_Data(0x00);
    	}

    }



}

/** @brief Debug OLED for being on the testbench
 *
 */
void oledDebugTask(void* args){

	for(;;){

	}

}

#endif


